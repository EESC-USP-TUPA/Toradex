/dts-v1/;
/plugin/;

/ {
    compatible = "toradex,verdin-imx8mm";

    fragment@0 {
        target = <&uart2>;
        __overlay__ {
            status = "okay";
        };
    };

    fragment@1 {
        target = <&iomuxc>;
        __overlay__ {
            pinctrl_uart2_custom: uart2grp {
                fsl,pins = <
                    MX8MM_IOMUXC_UART2_RXD_UART2_DCE_RX 0x140
                    MX8MM_IOMUXC_UART2_TXD_UART2_DCE_TX 0x140
                >;
            };
        };
    };

    fragment@2 {
        target = <&uart2>;
        __overlay__ {
            pinctrl-names = "default";
            pinctrl-0 = <&pinctrl_uart2_custom>;
        };
    };
};
